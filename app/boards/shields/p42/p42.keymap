#include <behaviors.dtsi>
#include <dt-bindings/zmk/bt.h>
#include <dt-bindings/zmk/keys.h>
#include <dt-bindings/zmk/outputs.h>
#include <dt-bindings/zmk/pointing.h>
#include <dt-bindings/zmk/pointing.h>


#define DEFAULT 0
#define NUMBER  1

/ {

    keymap {
        compatible = "zmk,keymap";

        // default_layer {
        //     label = "DEFAULT";
        //     bindings = <
        //         &kp ESC    &kp Q    &kp W     &kp E     &kp R     &kp T     &kp Y     &kp U     &kp I     &kp O     &kp P     &kp PLUS   &kp RET    &kp KP_N5  &kp MINUS
        //         &kp TAB    &kp A    &kp S     &kp D     &kp F     &kp G     &kp H     &kp J     &kp K     &kp L     &kp ENTER &kp KP_N7  &kp KP_N8  &kp KP_N9  &kp EQUAL
        //         &kp LSHFT  &kp Z    &kp X     &kp C     &kp V     &kp B     &kp N     &kp M     &kp COMMA &kp DOT   &mo 1  &kp KP_N4  &kp KP_N5  &kp KP_N6  &kp SQT
        //         &kp LCTRL  &kp LWIN &kp LALT  &kp SPACE &none     &none     &kp SPACE &kp LEFT  &kp DOWN  &kp RIGHT &kp BSPC  &kp KP_N1  &kp KP_N2  &kp KP_N3  &kp BSLH
        //     >;
        // };


    };
};
