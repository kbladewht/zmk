#include <dt-bindings/zmk/matrix_transform.h>
#include <physical_layouts.dtsi>
/ {
    chosen {
       
   zmk,physical-layout = &p42;
      
    };

   kscan0: kscan {        
		compatible = "zmk,kscan-gpio-matrix";
		label = "KSCAN";
        wakeup-source;
		
        row-gpios = <
        &gpio0 31 (GPIO_PULL_UP | GPIO_ACTIVE_LOW)
        &gpio0 0 (GPIO_PULL_UP | GPIO_ACTIVE_LOW)
        &gpio0 1 (GPIO_PULL_UP | GPIO_ACTIVE_LOW)
        &gpio0 4 (GPIO_PULL_UP | GPIO_ACTIVE_LOW)
        >;
	};



p42: p42 {
		compatible = "zmk,physical-layout";
		display-name = "matrix layout";
	    kscan = <&kscan0>;
		transform = <&default_transform>;
    };


};


