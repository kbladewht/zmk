## app/boards/shields/cornix_dongle_adapter/Kconfig.defconfig
```kconfig
if SHIELD_CORNIX_DONGLE_ADAPTER
endif # END ALL

#vim: set ft=kconfig:
config ZMK_KEYBOARD_NAME
    default "ADAPTER_CORNIX"
```

## app/boards/shields/donki36/Kconfig.shield
```kconfig
# Copyright (c) 2020 Pete Johanson
# SPDX-License-Identifier: MIT


config SHIELD_DONKI36_LEFT
	def_bool $(shields_list_contains,donki36_left)

config SHIELD_DONKI36_RIGHT
	def_bool $(shields_list_contains,donki36_right)
```

## app/boards/shields/p42/Kconfig.defconfig
```kconfig
if SHIELD_P42_C

config ZMK_KEYBOARD_NAME
	default "P42-usb"

config ZMK_SPLIT_ROLE_CENTRAL
	default y

endif

if SHIELD_P42_LEFT || SHIELD_P42_RIGHT || SHIELD_P42_C

config ZMK_SPLIT
	default y
	
endif
```

## app/boards/shields/p42/Kconfig.shield
```kconfig
config SHIELD_P42_LEFT
    def_bool $(shields_list_contains,p42_left)

config SHIELD_P42_C
    def_bool $(shields_list_contains,p42_c)

config SHIELD_P42_RIGHT
    def_bool $(shields_list_contains,p42_right)

config ZMK_QF_595
    bool "Enable my 595"
    default y
```
