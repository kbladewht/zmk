## app/boards/nicekeyboards/nice_nano_832/Kconfig.nice_nano_832
```kconfig
# Copyright (c) 2020 Pete Johanson
# SPDX-License-Identifier: Apache-2.0

config BOARD_NICE_NANO_832
    select SOC_NRF52832_QFAA
    imply RETAINED_MEM
    imply RETENTION
    imply RETENTION_BOOT_MODE
```

## app/boards/nicekeyboards/nice_nano_832/board.yml
```yaml
board:
  name: nice_nano_832
  vendor: nicekeyboards
  socs:
    - name: nrf52832
  revision:
    format: major.minor.patch
    default: 2.0.0
    revisions:
      - name: 1.0.0
      - name: 2.0.0
```

## app/boards/nicekeyboards/nice_nano_q/board.yml
```yaml
board:
  name: nice_nano_q
  vendor: nicekeyboards
  socs:
    - name: nrf52833
  revision:
    format: major.minor.patch
    default: 2.0.0
    revisions:
      - name: 1.0.0
      - name: 2.0.0
```

## app/boards/shields/corne/Kconfig.shield
```kconfig
# Copyright (c) 2020 Pete Johanson
# SPDX-License-Identifier: MIT

config SHIELD_CORNE_LEFT
    def_bool $(shields_list_contains,corne_left)

config SHIELD_CORNE_DONGLE
    def_bool $(shields_list_contains,corne_dongle)

config SHIELD_CORNE_RIGHT
    def_bool $(shields_list_contains,corne_right)

config SHIELD_CORNE_RIGHT832
    def_bool $(shields_list_contains,corne_right832)

config SHIELD_CORNE_RIGHT_M
    def_bool $(shields_list_contains,corne_right_m)
    
config EEPROM_WEAR_LEVELING
    bool "Enable EEPROM wear leveling"
    default y
    help
      Enable wear leveling for EEPROM-like storage.
config ZMK_QF_595
    bool "Enable my 595"
    default n
```
